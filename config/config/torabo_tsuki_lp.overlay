#include <input/processors.dtsi>

&trackball_listener {
    input-processors = <&zip_xy_scaler 1 2>;

    scroller {
        layers = <2>;
        input-processors = <&zip_xy_to_scroll_mapper>, <&zip_scroll_scaler 1 4>;
    };
};
